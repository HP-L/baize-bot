/*
 * math3D.c
 *
 *  Created on: Oct 1, 2024
 *      Author: lake
 */

 /** 【【代码分享】STM32立体图形绘制，旋转函数，移植方便，分享给大家】https://www.bilibili.com/video/BV1U2421F7Sr?vd_source=ff1690e4e5392383461cb23fd4d922c6 */

#include "math3D.h"                  // Device header
#include "MathSin.h"

 float SIN[360] = {
	0.000000,0.017452,0.034899,0.052336,0.069756,0.087156,0.104528,0.121869,0.139173,0.156434,0.173648,0.190809,
	0.207912,0.224951,0.241922,0.258819,0.275637,0.292372,0.309017,0.325568,0.342020,0.358368,0.374607,0.390731,
	0.406737,0.422618,0.438371,0.453990,0.469472,0.484810,0.500000,0.515038,0.529919,0.544639,0.559193,0.573576,
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	-0.207912,-0.190809,-0.173648,-0.156434,-0.139173,-0.121869,-0.104528,-0.087156,-0.069756,-0.052336,-0.034899,-0.017452,
};

 float COS[360] = {
	1.000000,0.999848,0.999391,0.998630,0.997564,0.996195,0.994522,0.992546,0.990268,0.987688,0.984808,0.981627,
	0.978148,0.974370,0.970296,0.965926,0.961262,0.956305,0.951057,0.945519,0.939693,0.933580,0.927184,0.920505,
	0.913545,0.906308,0.898794,0.891007,0.882948,0.874620,0.866025,0.857167,0.848048,0.838671,0.829038,0.819152,
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	0.978148,0.981627,0.984808,0.987688,0.990268,0.992546,0.994522,0.996195,0.997564,0.998630,0.999391,0.999848,
};



int16_t Ox = 240/2; //原点横坐标
int16_t Oy = 320/2; //原点纵坐标
float Rect[24] = //定义三维向量坐标（此处为边长10的正方体）（X轴：平行于屏幕，向右为正）
{																											   //Y轴：垂直于屏幕，向前为正（指向屏幕）
	5,5,5,																								 //Z轴：平行于屏幕，垂直于XY轴，向上为正
	5,5,-5,
	-5,5,-5,
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	-5,-5,5,//背面四个点
};
void Cart_Point(int16_t x,int16_t y,uint16_t color)//以笛卡尔坐标系绘制点【横坐标，纵坐标，颜色】
{
	ST7789_DrawPixel(Ox + x,Oy - y,color);
}
void Cart_Line(int16_t x,int16_t y,int16_t x1,int16_t y1,uint16_t cor,uint8_t per)//画线
{
	int16_t i = 0;
	int16_t lx = 0;
	int16_t ly = 0;
	float dx = 0;
	float dy = 0;
	float xs = 0;
	float ys = 0;
	int16_t de = 0;
	x = x + Ox;
	x1 = x1 + Ox;
	y = Oy - y;
	y1 = Oy - y1;

	lx = abs(x1 - x);
	ly = abs(y1 - y);
	if(lx >= ly)
	{
		de = lx;
	}
	else
	{
		de = ly;
	}
	dx = (float)(x1 - x) / de;
	dy = (float)(y1 - y) / de;
	xs = (float)x + 0.5;
	ys = (float)y + 0.5;
	for(i = 0;i <= de;i ++)
	{
		if(!(i%per)){
		Cart_Point(xs - Ox,ys - Oy,cor);}
		xs = xs + dx;
		ys = ys + dy;
	}
}
void Cart_Coor(uint16_t color,uint8_t per)//绘制笛卡尔坐标系【颜色，虚化程度（1~10）】
{
	Cart_Line(-64,0,63,0,color,per);
	Cart_Line(0,32,0,-31,color,per);
}

void Cart_DrawFor(int16_t x,int16_t y,int16_t x1,int16_t y1,int16_t x2,int16_t y2,int16_t x3,int16_t y3,uint16_t cor,uint8_t per)
{
	//绘制任意实心四边形（敬请期待）

}
void Cart_DrawRect(int16_t x,int16_t y,int16_t x1,int16_t y1,uint16_t cor,uint8_t per)//画空心矩形
{
	Cart_Line(x,y,x1,y,cor,per);
	Cart_Line(x1,y,x1,y1,cor,per);
	Cart_Line(x1,y1,x,y1,cor,per);
	Cart_Line(x,y1,x,y,cor,per);
}
void Cart_DrawRound(int16_t ox,int16_t oy,uint8_t r,uint16_t co)//画空心圆
{
	int x = 0;
	int y = r;
	int d =3 - 2 * r;
	while(x <= y)
	{
		Cart_Point(ox + x,oy + y,co);
		Cart_Point(ox - x,oy + y,co);
		Cart_Point(ox - x,oy - y,co);
		Cart_Point(ox + x,oy - y,co);
		Cart_Point(ox + y,oy + x,co);
		Cart_Point(ox - y,oy + x,co);
		Cart_Point(ox - y,oy - x,co);
		Cart_Point(ox + y,oy - x,co);
		if(d < 0)
		{
			d  += 4 * x + 6;
		}
		else
		{
			d += 4 * (x - y) + 10;
			y --;
		}
		x ++;
	}
}
void Cart_DrawFRound(uint8_t ox,uint8_t oy,uint8_t r,uint16_t cor)//画实心圆
{
	int x = 0;
	int y = r;
	int d =3 - 2 * r;
	while(x <= y)
	{
		Cart_Line(ox + x,oy + y,ox - x,oy + y,cor,1);
		Cart_Line(ox + y,oy + x,ox - y,oy + x,cor,1);
		Cart_Line(ox + y,oy - x,ox - y,oy - x,cor,1);
		Cart_Line(ox + x,oy - y,ox - x,oy - y,cor,1);
		if(d < 0)
		{
			d  += 4 * x + 6;
		}
		else
		{
			d += 4 * (x - y) + 10;
			y --;
		}
		x ++;
	}
}

void Se_Rotation(uint16_t Angle,float AD2[],uint8_t len)//二维旋转矩阵，对指定数组内坐标进行旋转变换
{																											 //【角度，坐标数组（大小必须为2的倍数，表示任意数量点的坐标（x,y）），数组长度】
	float a = 0,b = 0;
	for(uint16_t i = 0;i < len;i = i + 2)
	{
		a = AD2[i];
		b = AD2[i + 1];
		AD2[i] = (a * COS[Angle]) - (b * SIN[Angle]);
		AD2[i + 1] = (a * SIN[Angle]) + (b * COS[Angle]);//旋转矩阵，变换坐标
	}
}
void Th_Rotation(uint16_t Angle,float AD3[],uint8_t Rot,uint8_t len)//三维旋转矩阵，对指定数组内坐标进行旋转变换
{																											 //【角度，坐标数组（大小必须为3的倍数，表示任意数量点的坐标（x,y,z）），转轴（X,Y,Z）,数组长度】
	float a = 0,b = 0,c = 0;
	switch(Rot)
	{
		case(X)://X轴
		{
			for(uint16_t i = 0;i < len;i = i + 3)
			{
				b = AD3[i + 1];
				c = AD3[i + 2];
				AD3[i + 1] = (c * SIN[Angle]) + (b * COS[Angle]);
				AD3[i + 2] = (c * COS[Angle]) - (b * SIN[Angle]);//旋转矩阵，变换坐标
			}
		}
		case(Y)://Y轴
		{
			for(uint16_t i = 0;i < len;i = i + 3)
			{
				a = AD3[i];
				c = AD3[i + 2];
				AD3[i] = (a * COS[Angle]) - (c * SIN[Angle]);
				AD3[i + 2] = (a * SIN[Angle]) + (c * COS[Angle]);//旋转矩阵，变换坐标
			}
		}
		case(Z)://Z轴
		{
			for(uint16_t i = 0;i < len;i = i + 3)
			{
				a = AD3[i];
				b = AD3[i + 1];
				AD3[i] = (a * COS[Angle]) - (b * SIN[Angle]);
				AD3[i + 1] = (a * SIN[Angle]) + (b * COS[Angle]);//旋转矩阵，变换坐标
			}
		}
	}
}
void Th_Projection(float AD3[],float AD2[],int16_t l,int16_t n,uint16_t len)//将三维向量投影到二维平面上（屏幕上）
{																																						//【输入3维坐标数组，输出二维坐标数组，L：相机距离，N：视角，len：二维坐标数组长度】
	uint16_t num = 0;
	for(uint16_t i = 0;i < len;i = i + 2)
	{
		AD2[i] = l * (AD3[num] / (n - AD3[num + 1]));
		AD2[i + 1] = l * (AD3[num + 2] / (n - AD3[num + 1]));
		num = num + 3;
	}
}
void Cart_Draw3DRect(float AD2[],float lAD2[],uint8_t color,uint8_t per)//根据二维投影数组绘制八顶点图形（典型：正方体，长方体，四棱台）
{																																				 //【输入二维数组，输入二维影子数组（大小类型相同，用于清除痕迹），颜色，虚化比例（1~10）】
		Cart_Line(lAD2[0],lAD2[1],lAD2[2],lAD2[3],Black,per);
		Cart_Line(AD2[0],AD2[1],AD2[2],AD2[3],color,per);

		Cart_Line(lAD2[2],lAD2[3],lAD2[4],lAD2[5],Black,per);
		Cart_Line(AD2[2],AD2[3],AD2[4],AD2[5],color,per);

		Cart_Line(lAD2[4],lAD2[5],lAD2[6],lAD2[7],Black,per);
		Cart_Line(AD2[4],AD2[5],AD2[6],AD2[7],color,per);

		Cart_Line(lAD2[6],lAD2[7],lAD2[0],lAD2[1],Black,per);
		Cart_Line(AD2[6],AD2[7],AD2[0],AD2[1],color,per);//正面

		Cart_Line(lAD2[8],lAD2[9],lAD2[10],lAD2[11],Black,per);
		Cart_Line(AD2[8],AD2[9],AD2[10],AD2[11],color,per);

		Cart_Line(lAD2[10],lAD2[11],lAD2[12],lAD2[13],Black,per);
		Cart_Line(AD2[10],AD2[11],AD2[12],AD2[13],color,per);

		Cart_Line(lAD2[12],lAD2[13],lAD2[14],lAD2[15],Black,per);
		Cart_Line(AD2[12],AD2[13],AD2[14],AD2[15],color,per);

		Cart_Line(lAD2[14],lAD2[15],lAD2[8],lAD2[9],Black,per);
		Cart_Line(AD2[14],AD2[15],AD2[8],AD2[9],color,per);//背面

		Cart_Line(lAD2[0],lAD2[1],lAD2[8],lAD2[9],Black,per);
		Cart_Line(AD2[0],AD2[1],AD2[8],AD2[9],color,per);

		Cart_Line(lAD2[2],lAD2[3],lAD2[10],lAD2[11],Black,per);
		Cart_Line(AD2[2],AD2[3],AD2[10],AD2[11],color,per);

		Cart_Line(lAD2[4],lAD2[5],lAD2[12],lAD2[13],Black,per);
		Cart_Line(AD2[4],AD2[5],AD2[12],AD2[13],color,per);

		Cart_Line(lAD2[6],lAD2[7],lAD2[14],lAD2[15],Black,per);
		Cart_Line(AD2[6],AD2[7],AD2[14],AD2[15],color,per);//侧面
	for(uint8_t i = 0;i < 16;i ++)
	{
		lAD2[i] = AD2[i];
	}
}
void Cart_SetRect(int16_t x,int16_t y,int16_t z)//调整长方体长宽高(实际值 = 输入值 * 2)
{
	Rect[0] = x;
	Rect[3] = x;
	Rect[6] = -x;
	Rect[9] = -x;
	Rect[12] = x;
	Rect[15] = x;
	Rect[18] = -x;
	Rect[21] = -x;
	Rect[1] = y;
	Rect[4] = y;
	Rect[7] = y;
	Rect[10] = y;
	Rect[13] = -y;
	Rect[16] = -y;
	Rect[19] = -y;
	Rect[22] = -y;
	Rect[2] = z;
	Rect[5] = -z;
	Rect[8] = -z;
	Rect[11] = z;
	Rect[14] = z;
	Rect[17] = -z;
	Rect[20] = -z;
	Rect[23] = z;
}
void Cart_Draw3DFRect(float AD3[],float AD2[],float lAD2[],uint16_t color,uint8_t per)
{
	//绘制实心立方体（敬请期待）
//	float a = 0,b = 0,c = 0,a1 = 0,b1 = 0,c1 = 0;
//	float af = 0,bf = 0,cf = 0;
//	a = AD3[3] - AD3[0];
//	b = AD3[4] - AD3[1];
//	c = AD3[5] - AD3[2];
//	a1 = AD3[6] - AD3[0];
//	b1 = AD3[7] - AD3[1];
//	c1 = AD3[8] - AD3[2];
//	af = (b * c1) - (b1 * c);
//	bf = (c * a1) - (c1 * a);
//	cf = (a * b1) - (a1 * b);
}
